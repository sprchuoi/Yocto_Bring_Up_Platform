## meta-custom/conf/layer.conf
```bitbake
#@TYPE: Layer
#@NAME: meta-custom
#@DESCRIPTION: Custom BeagleBone industrial layer

BBPATH .= ":${LAYERDIR}"

BBFILES += "${LAYERDIR}/recipes-*/*/*.bb \
            ${LAYERDIR}/recipes-*/*/*.bbappend"

BBFILE_COLLECTIONS += "meta-custom"
BBFILE_PATTERN_meta-custom = "^${LAYERDIR}/"
BBFILE_PRIORITY_meta-custom = "7"

LAYERSERIES_COMPAT_meta-custom = "kirkstone"
LAYERDEPENDS_meta-custom = "core"
```
